## drivers/input/touchscreen/focaltech_touch/Kconfig
```kconfig
#
# Focaltech Touchscreen driver configuration
#

config TOUCHSCREEN_FOCALTECH
	tristate "Focaltech Touchscreen"
	help
	  Say Y here if you have Focaltech touch panel.
	  If unsure, say N.

config TOUCHSCREEN_FOCALTECH_DIRECTORY
	string "Focaltech ts directory name"
	default "focaltech_touch"
	depends on TOUCHSCREEN_FOCALTECH

config FOCALTECH_TRUSTED_TOUCH
	bool "Focaltech Trusted Touch"
	depends on TOUCHSCREEN_FOCALTECH
	help
	  Say Y here to enable Focaltech Trusted Touch.
	  If unsure, say N.

#endif
```
